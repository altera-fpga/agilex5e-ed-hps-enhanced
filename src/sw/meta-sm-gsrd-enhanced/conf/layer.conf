## src/sw/meta-sm-gsrd-enhanced/conf/layer.conf
```bitbake
# We have a conf and classes directory, add to BBPATH
BBPATH .= ":${LAYERDIR}"

# We have recipes-* directories, add to BBFILES
BBFILES += "${LAYERDIR}/recipes-*/*/*.bb \
            ${LAYERDIR}/recipes-*/*/*.bbappend"

BBFILE_COLLECTIONS += "meta-sm-gsrd-enhanced"
BBFILE_PATTERN_meta-sm-gsrd-enhanced = "^${LAYERDIR}/"
BBFILE_PRIORITY_meta-sm-gsrd-enhanced = "21"

LAYERDEPENDS_meta-sm-gsrd-enhanced = "core meta-intel-fpga-refdes meta-intel-fpga"
LAYERSERIES_COMPAT_meta-sm-gsrd-enhanced = "master styhead"

BBDEBUG = "yes"
```
